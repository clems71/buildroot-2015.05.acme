## configs/odroic-c1_defconfig
```kconfig
BR2_arm=y
BR2_cortex_a5=y
BR2_GLOBAL_PATCH_DIR="board/odroid/c1/patches"
BR2_TOOLCHAIN_EXTERNAL=y
BR2_TARGET_GENERIC_HOSTNAME="odroid-c1"
BR2_TARGET_GENERIC_ISSUE="Welcome to Odroid C1"
BR2_ROOTFS_DEVICE_CREATION_DYNAMIC_MDEV=y
BR2_TARGET_GENERIC_ROOT_PASSWD="odroid"
BR2_TARGET_GENERIC_GETTY_PORT="ttyAML0"
BR2_ROOTFS_OVERLAY="board/odroid/c1/rootfs_overlay"
BR2_LINUX_KERNEL=y
BR2_LINUX_KERNEL_CUSTOM_VERSION=y
BR2_LINUX_KERNEL_CUSTOM_VERSION_VALUE="4.4.3"
BR2_LINUX_KERNEL_USE_CUSTOM_CONFIG=y
BR2_LINUX_KERNEL_CUSTOM_CONFIG_FILE="board/odroid/c1/linux-4.4.3.config"
BR2_LINUX_KERNEL_UIMAGE_LOADADDR="0x00208000"
BR2_LINUX_KERNEL_DTS_SUPPORT=y
BR2_LINUX_KERNEL_USE_CUSTOM_DTS=y
BR2_LINUX_KERNEL_CUSTOM_DTS_PATH="board/odroid/c1/meson8b_odroidc.dts"
BR2_PACKAGE_OPROFILE=y
BR2_PACKAGE_FBDUMP=y
BR2_PACKAGE_FBGRAB=y
BR2_PACKAGE_FB_TEST_APP=y
BR2_PACKAGE_OPENSSH=y
BR2_PACKAGE_NANO=y
# BR2_TARGET_ACMEAT91BOOTSTRAP is not set
BR2_PACKAGE_HOST_MKE2IMG=y
```
